## arch/arm/mach-msm/lge/Kconfig
```kconfig
config MACH_LGE
	bool

menu "LGE Board Selection"


config MACH_MSM8926_MADAI
        depends on ARCH_MSM8226
        select MACH_LGE
        bool "MSM8926 MADAI"
        help
          Support for the Qualcomm MSM8926 MADAI device.


endmenu

menu "LGE Specific Patches"

config LGE_BOOTLOADER_LOG
	tristate "Support LGE bootloader log"
	default n
	depends on MACH_LGE
	help
	  LGE bootloader log

config LGE_HANDLE_PANIC
	tristate "Support LGE Kernel Panic Handler"
	default n
	depends on MACH_LGE
	help
	  LGE Error handler

config LGE_BOOTLOADER_TIME_CHECKER
	bool "Show bootloader(LK, SBL) time"
	default n
	depends on MACH_LGE
	help
	  This shows the lk and sbl1 booting time in MSM8974.
	  If this feature is enabled, it should be check by adb shell.
	  Device Node : sys/module/lge_bootloader_time_checker/

config LGE_USE_CPU_CLOCK_TIMESTAMP
	bool "Print local time stamp for debugging"
	default n
	depends on MACH_LGE
	help
	  Print kernel time with local time for helping debug.

config LGE_BNR_RECOVERY_REBOOT
	bool "Support PC suite BNR recovery reboot"
	default y
	depends on MACH_LGE
	help
	  Support PC suite BNR recovery reboot. bnr recovery mode
	  could be entered with reboot --bnr_recovery cmd.

config LGE_QFPROM_INTERFACE
	bool "Support qfprom interface"
	default n
	depends on MACH_LGE
	help
	  LGE QFPROM DRIVER.

config LGE_ENABLE_MMC_STRENGTH_CONTROL
	bool "Support MMC Strength Control"
	default n
	depends on MACH_LGE
	help
	  LGE mmc data,cmd,clk strength control support


config LGE_PM_BATTERY_CAPACITY_2440mAh
	bool "Support Battery Capacity : 2440mAh"
	depends on LGE_PM_BATTERY_PROFILE_DATA
	help
	  LGE battery capacity for 2440mAh

config LGE_CRASH_FOOTPRINT
	boolean "Crash footprint for MLT"
	default n
	depends on MACH_LGE && LGE_HANDLE_PANIC
	help
	  This feature is crash footprint for MLT.
	  This refers to lge.bootreason and give information if the crash occured in previous to MLT.
	  Device Node : /sys/module/lge_handle_panic/parameters/crash_footprint

config PRE_SELF_DIAGNOSIS
	tristate "Support LGE self diagnosis for factory"
	default n
	depends on MACH_LGE
	help
	  LGE self diagnosis

config LGE_DIAG_BYPASS
       tristate "Support LGE diag bypass for factory"
       default n
       depends on MACH_LGE
       help
	  LGE diag bypass

endmenu
```
